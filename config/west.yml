## config/west.yml
```yaml
manifest:
  remotes:
    - name: zmkfirmware
      url-base: https://github.com/zmkfirmware
    - name: sekigon-gonnoc
      url-base: https://github.com/sekigon-gonnoc

  projects:
    - name: zmk
      remote: zmkfirmware
      revision: main
      import: app/west.yml
    - name: zmk-component-ble-micro-pro
      remote: sekigon-gonnoc
      revision: main
    - name: zmk-feature-non-lipo-battery-management
      remote: sekigon-gonnoc
  self:
    path: config
```
